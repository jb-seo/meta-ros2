## conf/layer.conf
```bitbake
# We have a conf and classes directory, append to BBPATH
BBPATH .= ":${LAYERDIR}"

# We have a recipes directory, add to BBFILES
BBFILES += "${LAYERDIR}/recipes-*/*/*.bb ${LAYERDIR}/recipes-*/*/*.bbappend"

BBFILE_COLLECTIONS += "ros-layer"
BBFILE_PATTERN_ros-layer := "^${LAYERDIR}/"
BBFILE_PRIORITY_ros-layer = "7"

LICENSE_PATH += "${LAYERDIR}/licenses"

LAYERSERIES_COMPAT_ros-layer = "thud"
LAYERVERSION_ros-layer = "2"

export ROS_DISTRO ?= "crystal"

# All generated recipes set this to "1".
ROS_SUPERFLORE_GENERATED ??= "0"

require conf/${ROS_DISTRO}/generated-ros-distro.conf

# Only .bb files are generated
BBFILES += "${LAYERDIR}/generated-recipes-${ROS_DISTRO}/*/*.bb"

ROS_LAYERDIR := "${LAYERDIR}"
```
